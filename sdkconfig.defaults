## sdkconfig.defaults
```kconfig
CONFIG_IDF_TARGET="esp32p4"
CONFIG_ESP_SYSTEM_PANIC_PRINT_HALT=y
CONFIG_SPIRAM_BOOT_INIT=y
CONFIG_CAMERA_SSC_ENABLE=y
CONFIG_H264_DMA_ENABLE=y
CONFIG_ESP_WIFI_ENABLED=y
CONFIG_ESP_WIFI_STA_AUTO_CONNECT=y
CONFIG_ETH_ENABLED=y
CONFIG_ESP_NETIF_IP_LOST_TIMER_INTERVAL=120
```
